#include <stdarg.h>
#include <stdio.h>
#include <stdint.h>
#include <stdlib.h>
#include <string.h>

//#include "ARMCM3.h"
#include "CMSDK_CM3.h"
#include "sha256_t.h"
#include <mbedtls.h>

extern void UartStdOutInit(void);
extern void delay_us(int us);

extern int sha256_test();
extern void sha256_hmac_test(uint8_t* result);
extern void sha256_hmac_test_sw(uint8_t* result);
extern int ecdh_pkcc_function_call_test();
extern void ec_elgamal_test();
extern void ecdsa_sign_function_test();
extern void ecdsa_verify_function_test();
extern void rsa_test_encrypt(uint32_t* msg,uint32_t *res);
extern void rsa_test_decrypt(uint32_t *msg, uint32_t* res);
extern void aes_gcm_test();

extern void ecc_ECPD_256_test();
extern void ecc_MS_256_test();
extern void ecc_MD_256_test();

extern void GPIO_reset();
extern int finger_print_test();
extern void init_master_spi(void);
extern void spi_read_write(uint8_t *txd, unsigned int tSize, uint8_t *rxd, unsigned int rSize);


#define SHA256_TEST_BLOCK 			0
#define PKCC_RSA_TEST_BLOCK 		1
#define SDCP_TEST_BLOCK				0

#define RAM_START             ((volatile unsigned int *)(0x20000000))


extern void init_interrupt();

unsigned int sys_msec = 1;

void SysTick_Handler(void)
{
	//printf("SysTick_Handler\r\n");
	sys_msec++;
}

void sha256(uint8_t *mess, uint32_t size, uint8_t *buf){
		SHA256_CTX ctx;
		sha256_init(&ctx);
		sha256_update(&ctx, mess, size);
		sha256_final(&ctx, buf);
}

int main(){
		int ret = 1;

		// initialize Uart
		UartStdOutInit();
		
		// initialize spi
		init_master_spi();
		
		// General Purpose Input/Output reset
		// RST_N RESET
		GPIO_reset();
    
		// give delay to board
		delay_us(1000);
		printf("\r\n CM8 INIT END");
		

		uint8_t *pdata;
		uint8_t data[268] = {0xDC, 0x18, 0x00, 0x00, 0x75, 0x27, 0x00, 0x00, 0xC9, 0x2E, 0x0D, 0xFA, 
			0x91, 0xD7, 0x11, 0x5A, 0x77, 0x32, 0xA5, 0x5A, 0x81, 0x7B, 0xA9, 0x29, 
			0xD8, 0xEF, 0x0D, 0x2B, 0xA0, 0x0A, 0x43, 0x5E, 0xDA, 0xDC, 0x60, 0x5F, 
			0xE7, 0xB7, 0x8A, 0x8B, 0x2B, 0x5B, 0x6E, 0xF5, 0x5B, 0xD0, 0x9C, 0x6D,
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		0x01, 0x00, 0x01, 0x00	};
		pdata = (uint8_t*)0x4FEF4;
		for(int i = 0; i < 268; i++){
			*(pdata+i) = data[i];
		}
    uint32_t *signature;
		signature = (uint32_t*)0x4FDF4;
		
		uint32_t *size;
		size = (uint32_t*)(signature+64);
		
		uint32_t * ver;
		ver = (size+1);
		
	  uint8_t *pubkey_2nd;
		pubkey_2nd = (uint8_t*)(ver+1);
		
		uint8_t *message;
		message = pubkey_2nd;
		uint8_t hash[32];
		uint32_t result[64], hash_padding[64];

		int length = (int)(*size);
		length += 260;
		//check flash data
		//		for(int i = 0; i<size;i++) printf(" %02x", *(message + i));			
		
		//hashing
		sha256(message, length, hash);
		
		//print hash and input in msg
		printf("\r\nSHA256 RESULT: ");
		for(int i = 0; i < 32; i++) {printf("%02x ", hash[i]); hash_padding[i] = hash[i];}
		printf("\n\n");
	
		//make a signature
		rsa_test_encrypt(hash_padding,signature);
		printf("\r\n=======================================================================\n");
		//verify
		rsa_test_decrypt(signature,result);
		printf("\r\n=======================================================================\n");
		
		//RSA result check
		for(int i = 0; i < 64; i++){
			if(result[i] != hash_padding[i]){
				printf("RSA_FAILED");
				return 123;
			}
		}
		printf("\n\nRSA_SUCCESSED\n\n");
		
		(*(void(*)())(0x00050131))();

		printf("\r\n ALL TEST END\n");


		return 0;
 }
