#include <stdarg.h>
#include <stdio.h>
#include <stdint.h>
#include <stdlib.h>
#include <string.h>

// #include "ARMCM3.h"
#include "CMSDK_CM3.h"
#include "sha256_t.h"
#include <mbedtls.h>

extern void UartStdOutInit(void);
extern void delay_us(int us);

extern int sha256_test();
extern void sha256_hmac_test(uint8_t *result);
extern void sha256_hmac_test_sw(uint8_t *result);
extern int ecdh_pkcc_function_call_test();
extern void ec_elgamal_test();
extern void ecdsa_sign_function_test();
extern void ecdsa_verify_function_test();
extern void rsa_test_encrypt(uint32_t *msg, uint32_t *res);
extern void rsa_test_decrypt(uint32_t *msg, uint32_t *res, uint32_t *n, uint32_t *e);
extern void aes_gcm_test();

extern void ecc_ECPD_256_test();
extern void ecc_MS_256_test();
extern void ecc_MD_256_test();

extern void GPIO_reset();
extern int finger_print_test();
extern void init_master_spi(void);
extern void spi_read_write(uint8_t *txd, unsigned int tSize, uint8_t *rxd, unsigned int rSize);

#define RAM_START ((volatile unsigned int *)(0x20000000))

extern void init_interrupt();

unsigned int sys_msec = 1;

void SysTick_Handler(void)
{
	// printf("SysTick_Handler\r\n");
	sys_msec++;
}

void sha256(uint8_t *mess, uint32_t size, uint8_t *buf)
{
	SHA256_CTX ctx;
	sha256_init(&ctx);
	sha256_update(&ctx, mess, size);
	sha256_final(&ctx, buf);
}

int main()
{
	int ret = 1;

	// initialize Uart
	UartStdOutInit();

	// initialize spi
	init_master_spi();

	// General Purpose Input/Output reset
	// RST_N RESET
	GPIO_reset();

	// give delay to board
	delay_us(1000);
	printf("\r\n CM8 INIT END");

	uint32_t *pubkey_1st_n;
	uint32_t pubkey_1st_e[64];
	uint8_t *putdata;
	const uint8_t kdata[260] = {0x6F, 0xB7, 0xA5, 0x69, 0xE4, 0x40, 0x36, 0x3D, 0xE4, 0x5D, 0xBD, 0xE5, 0x19, 0xA3, 0x99, 0x28,
								0xD9, 0xF4, 0xAC, 0x85, 0x12, 0x1B, 0x75, 0x26, 0x85, 0x1A, 0xDF, 0x1E, 0x62, 0xD4, 0xAE, 0x42,
								0xF5, 0xEE, 0xA0, 0x43, 0x94, 0xB8, 0xB3, 0xA6, 0x7B, 0x38, 0xAB, 0x02, 0x31, 0x9C, 0x0E, 0x5D,
								0x5F, 0xF0, 0xD9, 0xD5, 0xA9, 0x99, 0xA1, 0x65, 0x8D, 0x95, 0xD5, 0x23, 0x93, 0x55, 0x21, 0xA0,
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								0x01, 0x00, 0x01, 0x00};
	putdata = (uint8_t *)0x21000;
	for (int i = 0; i < 524; i++)
	{
		*(putdata + i) = kdata[i];
	}

	pubkey_1st_n = (uint32_t *)putdata;
	pubkey_1st_e[63] = *(pubkey_1st_n + 64);

	uint8_t *pdata;
	const uint8_t data[524] = {0x76, 0x4D, 0x32, 0x2F, 0x48, 0xB5, 0x94, 0x4E, 0xD1, 0x87, 0xE4, 0x5A, 0x1D,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 0x1D,
							   0x06, 0x14, 0x10, 0xA4, 0x6D, 0x4D, 0x84, 0xDD, 0x8A, 0xFA, 0x13, 0x65,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 0xC7,
							   0x24, 0x34, 0x7E, 0x2D, 0x54, 0xAA, 0x44, 0xEB, 0xB0, 0x19, 0x97, 0x51,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 0x01, 0x00};
	pdata = (uint8_t *)0x2FDF4;
	for (int i = 0; i < 524; i++)
	{
		*(pdata + i) = data[i];
	}

	uint32_t *sign;
	sign = (uint32_t *)pdata;

	uint32_t *size;
	size = (sign + 64);

	uint32_t *ver;
	ver = (size + 1);

	uint8_t *pubkey_2nd;
	pubkey_2nd = (uint8_t *)(ver + 1);

	uint8_t *message;
	message = (uint8_t *)size;
	uint8_t hash[32];
	uint32_t result[64], what_we_made[64];
	// uint32_t hash_padding[64];
	uint8_t hash_padding[256];

	int length = (int)(*size);
	length += 268;
	// check flash data
	// for(int i = 0; i<size;i++) printf(" %02x", *(message + i));

	// hashing
	sha256(message, length, hash);

	// print hash and input in msg

	printf("\r\nSHA256 RESULT: ");
	for (int i = 4; i < 36; i++)
	{
		printf("%02x ", hash[i - 4]);
		hash_padding[i] = *(hash + i - 4);
	}
	printf("\n\n");

	rsa_test_decrypt(sign, result, pubkey_1st_n, pubkey_1st_e);
	printf("\r\n=======================================================================\n");

	// RSA result check
	for (int i = 0; i < 64; i++)
	{
		if (result[i] != *((uint32_t *)hash_padding + i))
		{
			printf("2nd bootloader damaged (modified)");
			return 123;
		}
	}
	printf("\n\nRSA_SUCCESSED\n\n");

	delay_us(1000);

	uint32_t *rjar;
	uint32_t *jar = (uint32_t *)0x30004;
	(*(void (*)())(*jar))();

	printf("\r\n ALL TEST END\n");

	return 0;
}