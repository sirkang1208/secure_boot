#include <stdarg.h>
#include <stdio.h>
#include <stdint.h>
#include <stdlib.h>
#include <string.h>

//#include "ARMCM3.h"
#include "CMSDK_CM3.h"
#include "sha256_t.h"
#include <mbedtls.h>

extern void UartStdOutInit(void);
extern void delay_us(int us);

extern int sha256_test();
extern void sha256_hmac_test(uint8_t* result);
extern void sha256_hmac_test_sw(uint8_t* result);
extern int ecdh_pkcc_function_call_test();
extern void ec_elgamal_test();
extern void ecdsa_sign_function_test();
extern void ecdsa_verify_function_test();
extern void rsa_test_encrypt(uint32_t* msg,uint32_t *res);
extern void rsa_test_decrypt(uint32_t *msg, uint32_t* res, uint32_t *n,uint32_t *e);
extern void aes_gcm_test();

extern void ecc_ECPD_256_test();
extern void ecc_MS_256_test();
extern void ecc_MD_256_test();


extern void GPIO_reset();
extern int finger_print_test();
extern void init_master_spi(void);
extern void spi_read_write(uint8_t *txd, unsigned int tSize, uint8_t *rxd, unsigned int rSize);

#define RAM_START             ((volatile unsigned int *)(0x20020000))
	
extern void init_interrupt();

unsigned int sys_msec = 1;

void SysTick_Handler(void)
{
	//printf("SysTick_Handler\r\n");
	sys_msec++;
}

void sha256(uint8_t *mess, uint32_t size, uint8_t *buf){
		SHA256_CTX ctx;
		sha256_init(&ctx);
		sha256_update(&ctx, mess, size);
		sha256_final(&ctx, buf);
}

int main(){
		int ret = 1;

		// initialize Uart
		UartStdOutInit();
		
		// initialize spi
		init_master_spi();
		
		// General Purpose Input/Output reset
		// RST_N RESET
		GPIO_reset();
	
		printf("\n\nBL2 jump success\n\n");
    
		// give delay to board
		delay_us(1000);
		
		printf("\r\n CM8 INIT END");
		
		uint8_t *pdata;
		const uint8_t Fdata[264] = {0xBA, 0xE3, 0xBA, 0x67, 0x59, 0x22, 0xF3, 0xDC, 0xD4, 0xE0, 0xF7, 0x07, 0xCE, 0xE8, 0xAB, 0xBA, 
			0xBE, 0xB2, 0x0D, 0x87, 0xBA, 0xC9, 0x89, 0x93, 0x73, 0x2B, 0xAF, 0xEA, 0x6B, 0xC2, 0xE4, 0x1B, 
			0xDD, 0xFD, 0x5F, 0xBE, 0x7D, 0xD9, 0x32, 0xA6, 0xE5, 0x38, 0xDB, 0xC4, 0xF9, 0x9B, 0x9D, 0x28, 
			0x3D, 0x88, 0xFC, 0x36, 0x38, 0x5D, 0xB1, 0xB7, 0x47, 0xFC, 0xBC, 0x10, 0xE7, 0xDC, 0x40, 0x66, 
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			0x44, 0x0B, 0x00, 0x00, 0x75, 0x27, 0x00, 0x00};
		pdata = (uint8_t*)0x5FEF8;
		for(int i = 0; i < 264; i++){
			*(pdata+i) = Fdata[i];
		}

		uint32_t *pubkey_2nd_n, *e;
		uint32_t pubkey_2nd_e[64];
		pubkey_2nd_n = (uint32_t*)0x2fefc;
		e = (pubkey_2nd_n+64);
		pubkey_2nd_e[63] = *e;
		
    uint32_t *sign;
		sign = (uint32_t*)pdata;
		
		uint32_t *size;
		size = (sign+64);
		
		uint32_t * ver;
		ver = (size+1);

		uint8_t *message;
		message = (uint8_t *)size;
		uint8_t hash[32];
		uint32_t result[64], what_we_made[64];
		//uint32_t hash_padding[64];
		uint8_t hash_padding[256];

		int length = (int)(*size);
		length += 8;
		
		//hashing
		sha256(message, length, hash);
		
		//print hash and input in msg

		printf("\r\nSHA256 RESULT: ");
		for(int i = 4; i < 36; i++) {printf("%02x ",hash[i-4]); hash_padding[i] = *(hash+i-4);}
		printf("\n\n");
		
		rsa_test_decrypt(sign,result, pubkey_2nd_n, pubkey_2nd_e);
		printf("\r\n=======================================================================\n");
		
		//RSA result check
		for(int i = 0; i < 64; i++){
			if(result[i] != *((uint32_t*)hash_padding+i)){ 
			printf("Firmware damaged (modified)"); return 123;}
		}
		printf("\n\nRSA_SUCCESSED\n\n");

		delay_us(1000);
  	
		uint32_t *rjar;
		uint32_t *jar = (uint32_t*)0x60004;
		(*(void(*)())(*jar))();


		printf("\r\n ALL TEST END\n");

	return 0;
 }
